&myaccip_0 {
    compatible = "generic-uio";

    /*
     * IRQ placeholder (do not enable yet):
     * If the generated node already has interrupts, leave them as-is.
     * If you later want userspace IRQ via UIO, switch to:
     * compatible = "uio_pdrv_genirq";
     */
};