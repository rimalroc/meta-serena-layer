## conf/layer.conf
```bitbake
# We have a conf and classes directory, add to BBPATH
BBPATH .= ":${LAYERDIR}"

# We have recipes-* directories, add to BBFILES
BBFILES += "${LAYERDIR}/recipes-*/*/*.bb \
            ${LAYERDIR}/recipes-*/*/*.bbappend"

BBFILE_COLLECTIONS += "meta-serena-layer"
BBFILE_PATTERN_meta-serena-layer = "^${LAYERDIR}/"
BBFILE_PRIORITY_meta-serena-layer = "6"

LAYERDEPENDS_meta-serena-layer = "core"
LAYERSERIES_COMPAT_meta-serena-layer = "scarthgap"
```
